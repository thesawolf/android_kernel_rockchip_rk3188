## arch/arm/mach-rk3188/Kconfig
```kconfig
choice
	prompt "Rockchip SoC Type"
	depends on ARCH_RK3188

config SOC_RK3188
	bool "RK3188"

endchoice

choice
	prompt "RK3188 Board Type"
	depends on SOC_RK3188

config MACH_RK3188_TB
	bool "RK3188 Top Board"

config MACH_RK3188_FPGA
	bool "RK3188 FPGA board"
	select RK_FPGA

config MACH_RK3188_LR097
        bool "RK3188 LR097 JC21CA board"

config MACH_RK3188_DS1006H
	bool "RK3188 ds1006h board"

config MACH_RK3188_BOX
	bool "RK3188 box board"
	
endchoice

menu "RK3188 OVERCLOCK"
 	depends on ARCH_RK3188 && MACH_RK3188_BOX

config OVERCLOCK_CPU
	bool "CPU Overclock"
	help
	  Standard CPU (over)clocking (up to 1.7GHz)

config EXTREME_OCCPU
	bool "- Extreme CPU O/C"
	help 
	  Does not work well on some devices (i.e. MK908)
	  Opens up overclocking to 2+ GHz

config OVERCLOCK_GPU
	bool "GPU Overclock"
	help 
	  Standard GPU (over)clocking (up to 600MHz)

config EXTERME_OCGPU
	bool "- Extreme GPU O/C"
	help
	  Does not work well on some devices (i.e. MK908)
	  Opens up overclocking step to 800MHz

config OVERCLOCK_RAM
	bool "RAM Overclock"
	help
	  Standard RAM (over)clocking (up to 800MHz)

config EXTREME_OCRAM
	bool "- Extreme RAM O/C"
	help
	  Open up overclocking DDR to XXXXMHz

config OVERVOLT_CPU
	bool "CPU Overvolting"
	help
	  This just opens up a little more voltage. 
	  This option can be tied into to various O/C features
	  later, as it is right now.. it just bumps standard voltage
	  from 1.375 to 1.450 

endmenu

config RK_VOLT1
	bool 
	default n

config RK_VOLT2
	bool
	default n
```

## block/Kconfig.iosched
```kconfig
if BLOCK

menu "IO Schedulers"

config IOSCHED_NOOP
	tristate "No-op I/O scheduler"
	default y
	---help---
	  The no-op I/O scheduler is a minimal scheduler that does basic merging
	  and sorting. Its main uses include non-disk based block devices like
	  memory devices, and specialised software or hardware environments
	  that do their own scheduling and require only minimal assistance from
	  the kernel.

config IOSCHED_SIO
	tristate "Simple I/O scheduler"
	default y
	---help---
          Simple I/O scheduler aims to keep minimum overhead to achieve low 
	  latency to serve I/O requests. No priority queues concepts, but only
	  basic merging. Sio is a mix between noop and deadline. No reordering
          or sorting of requests. 
       
          Adv: simple, reliable; minimized starvation of requests
	  Dis: slow random-read speeds on flash drives, compared to others;
	       sequential-read speeds on flash drives not so good

config IOSCHED_VR
	tristate "V(R) I/O scheduler"
	default y
	---help---
	  Unlike other schedulers, synchronous and asynchronous requests are
	  not treated separately, instead a deadline is imposed for fairness.
	  The next request to be served is based on its distance from last
    	  request.
	
	  Adv: Best for benchmarking
	  Dis: performance fluctuation results in below-average performance
               at times; least reliable/most unstable

config IOSCHED_ZEN
	tristate "Zen I/O scheduler"
	default y
	---help---
	  Awfully similar to SIO, although its a bit simpler than SIO 
          (closer to no-op) and works just slightly different. It is a
          FCFS (First come, first serve) based algorithm. It is not 
          strictly FIFO. It does not do any sorting. It uses deadlines 
          for fairness, and treats synchronous requests with priority 
          over asynchronous ones. Other than that, pretty much the same 
          as no-op.

config IOSCHED_DEADLINE
	tristate "Deadline I/O scheduler"
	default y
	---help---
	  The deadline I/O scheduler is simple and compact. It will provide
	  CSCAN service with FIFO expiration of requests, switching to
	  a new point in the service tree and doing a batch of IO from there
	  in case of expiry.

config IOSCHED_CFQ
	tristate "CFQ I/O scheduler"
	# If BLK_CGROUP is a module, CFQ has to be built as module.
	depends on (BLK_CGROUP=m && m) || !BLK_CGROUP || BLK_CGROUP=y
	default y
	---help---
	  The CFQ I/O scheduler tries to distribute bandwidth equally
	  among all processes in the system. It should provide a fair
	  and low latency working environment, suitable for both desktop
	  and server systems.

	  This is the default I/O scheduler.

	  Note: If BLK_CGROUP=m, then CFQ can be built only as module.

config IOSCHED_ROW
	tristate "ROW I/O scheduler"
	default y
	---help---
	  READ over WRITE scheduler. Optimal for mobile devices. Favour
	  user experience over everything else, thus given READ IO requests
	  as much priority as possible. In mobile devices, it will not have
	  AS much parallel threads as on desktops. Usually it is a single 
	  thread or at most 2 simultaneous working threads for read and
	  write. Favouring READ requests over WRITEs decreases the READ
	  latency greatly.

config CFQ_GROUP_IOSCHED
	bool "CFQ Group Scheduling support"
	depends on IOSCHED_CFQ && BLK_CGROUP
	default n
	---help---
	  Enable group IO scheduling in CFQ.

choice
	prompt "Default I/O scheduler"
	default DEFAULT_NOOP
	help
	  Select the I/O scheduler which will be used by default for all
	  block devices.

	config DEFAULT_DEADLINE
		bool "Deadline" if IOSCHED_DEADLINE=y

	config DEFAULT_CFQ
		bool "CFQ" if IOSCHED_CFQ=y

        config DEFAULT_SIO
		bool "SIO" if IOSCHED_SIO=y

	config DEFAULT_VR
		bool "VR" if IOSCHED_VR=y

	config DEFAULT_ZEN
                bool "ZEN" if IOSCHED_ZEN=y

	config DEFAULT_ROW
		bool "ROW" if IOSCHED_ROW=y
	
        config DEFAULT_NOOP
		bool "No-op" if IOSCHED_NOOP=y

endchoice

config DEFAULT_IOSCHED
	string
	default "deadline" if DEFAULT_DEADLINE
	default "cfq" if DEFAULT_CFQ
	default "noop" if DEFAULT_NOOP
	default "sio" if DEFAULT_SIO
	default "vr" if DEFAULT_VR
	default "zen" if DEFAULT_ZEN
	default "row" if DEFAULT_ROW

endmenu

endif
```
