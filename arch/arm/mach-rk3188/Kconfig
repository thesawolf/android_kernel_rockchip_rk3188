## drivers/cpufreq/Kconfig
```kconfig
menu "CPU Frequency scaling"

config CPU_FREQ
	bool "CPU Frequency scaling"
	help
	  CPU Frequency scaling allows you to change the clock speed of 
	  CPUs on the fly. This is a nice method to save power, because 
	  the lower the CPU clock speed, the less power the CPU consumes.

	  Note that this driver doesn't automatically change the CPU
	  clock speed, you need to either enable a dynamic cpufreq governor
	  (see below) after boot, or use a userspace tool.

	  For details, take a look at <file:Documentation/cpu-freq>.

	  If in doubt, say N.

if CPU_FREQ

config CPU_FREQ_TABLE
	tristate

config CPU_FREQ_STAT
	tristate "CPU frequency translation statistics"
	select CPU_FREQ_TABLE
	default y
	help
	  This driver exports CPU frequency statistics information through sysfs
	  file system.

	  To compile this driver as a module, choose M here: the
	  module will be called cpufreq_stats.

	  If in doubt, say N.

config CPU_FREQ_STAT_DETAILS
	bool "CPU frequency translation statistics details"
	depends on CPU_FREQ_STAT
	help
	  This will show detail CPU frequency translation table in sysfs file
	  system.

	  If in doubt, say N.

choice
	prompt "Default CPUFreq governor"
	default CPU_FREQ_DEFAULT_GOV_USERSPACE if CPU_FREQ_SA1100 || CPU_FREQ_SA1110
	default CPU_FREQ_DEFAULT_GOV_PERFORMANCE
	help
	  This option sets which CPUFreq governor shall be loaded at
	  startup. If in doubt, select 'performance'.

config CPU_FREQ_DEFAULT_GOV_PERFORMANCE
	bool "performance"
	select CPU_FREQ_GOV_PERFORMANCE
	help
	  Use the CPUFreq governor 'performance' as default. This sets
	  the frequency statically to the highest frequency supported by
	  the CPU.

config CPU_FREQ_DEFAULT_GOV_POWERSAVE
	bool "powersave"
	depends on EXPERT
	select CPU_FREQ_GOV_POWERSAVE
	help
	  Use the CPUFreq governor 'powersave' as default. This sets
	  the frequency statically to the lowest frequency supported by
	  the CPU.

config CPU_FREQ_DEFAULT_GOV_USERSPACE
	bool "userspace"
	select CPU_FREQ_GOV_USERSPACE
	help
	  Use the CPUFreq governor 'userspace' as default. This allows
	  you to set the CPU frequency manually or when a userspace 
	  program shall be able to set the CPU dynamically without having
	  to enable the userspace governor manually.

config CPU_FREQ_DEFAULT_GOV_ONDEMAND
	bool "ondemand"
	select CPU_FREQ_GOV_ONDEMAND
	select CPU_FREQ_GOV_PERFORMANCE
	help
	  Use the CPUFreq governor 'ondemand' as default. This allows
	  you to get a full dynamic frequency capable system by simply
	  loading your cpufreq low-level hardware driver.
	  Be aware that not all cpufreq drivers support the ondemand
	  governor. If unsure have a look at the help section of the
	  driver. Fallback governor will be the performance governor.

config CPU_FREQ_DEFAULT_GOV_ONDEMANDX
	bool "ondemandx"
	select CPU_FREQ_GOV_ONDEMANDX
	help
	  Use the CPUFreq governor 'ondemandx' as default. See 
	  ondemandx governor help for more details.

config CPU_FREQ_DEFAULT_GOV_CONSERVATIVE
	bool "conservative"
	select CPU_FREQ_GOV_CONSERVATIVE
	select CPU_FREQ_GOV_PERFORMANCE
	help
	  Use the CPUFreq governor 'conservative' as default. This allows
	  you to get a full dynamic frequency capable system by simply
	  loading your cpufreq low-level hardware driver.
	  Be aware that not all cpufreq drivers support the conservative
	  governor. If unsure have a look at the help section of the
	  driver. Fallback governor will be the performance governor.

config CPU_FREQ_DEFAULT_GOV_INTERACTIVE
	bool "interactive"
	select CPU_FREQ_GOV_INTERACTIVE
	help
	  Use the CPUFreq governor 'interactive' as default. This allows
	  you to get a full dynamic cpu frequency capable system by simply
	  loading your cpufreq low-level hardware driver, using the
	  'interactive' governor for latency-sensitive workloads.

config CPU_FREQ_DEFAULT_GOV_INTERACTIVEX
	bool "interactivex"
	select CPU_FREQ_GOV_INTERACTIVEX
	help
	  Use the CPUFreq governor 'interactivex' as default. See
	  interactivex governor help for more details.

config CPU_FREQ_DEFAULT_GOV_BRAZILIANWAX
	bool "brazilianwax"
	select CPU_FREQ_GOV_BRAZILIANWAX
	help
	  Use the CPUFreq governor 'brazilianwax' as default. See 
	  brazilianwax governor help for more details.

config CPU_FREQ_DEFAULT_GOV_SAVAGEDZEN
	bool "savagedzen"
	select CPU_FREQ_GOV_SAVAGEDZEN
	help
	  Use the CPUFreq governor 'savagedzen' as default. See
	  savagedzen governor help for more details.

config CPU_FREQ_DEFAULT_GOV_ADAPTIVE
	bool "adaptive"
	select CPU_FREQ_GOV_ADAPTIVE
	help
	  Use the CPUFreq governor 'adaptive' as default. See adaptive
	  governor help for more details.

config CPU_FREQ_DEFAULT_GOV_HYPER
	bool "hyper"
	select CPU_FREQ_GOV_HYPER
	help
	  Use the CPUFreq governor 'hyper' as default. See hyper
	  governor help for more details.

config CPU_FREQ_DEFAULT_GOV_INTELLIDEMAND
	bool "intellidemand"
	select CPU_FREQ_GOV_INTELLIDEMAND
	help
	  Use the CPUFreq governor 'intellidemand' as default. See
	  intellidemand governor help for more details.

config CPU_FREQ_DEFAULT_GOV_LIONHEART
	bool "lionheart"
	select CPU_FREQ_GOV_LIONHEART
	help
	  Use the CPUFreq governor 'lionheart' as default. See
	  lionheart governor help for more details.

config CPU_FREQ_DEFAULT_GOV_LULZACTIVE
	bool "lulzactive"
	select CPU_FREQ_GOV_LULZACTIVE
	help
	  Use the CPUFreq governor 'lulzactive' as default. See
	  lulzactive governor help for more details.

config CPU_FREQ_DEFAULT_GOV_SMARTASS2
	bool "smartass2"
	select CPU_FREQ_GOV_SMARTASS2
	select CPU_FREQ_GOV_PERFORMANCE
	help
	  Use the CPUFreq governor 'smartassV2' as default. See 
	  smartassV2 governor help for more details.

config CPU_FREQ_DEFAULT_GOV_MINMAX
	bool "minmax"
	select CPU_FREQ_GOV_MINMAX
	help
	  Use the CPUFreq governor 'minmax' as default. See minmax
	  governor help for more details.

endchoice

config CPU_FREQ_GOV_PERFORMANCE
	tristate "'performance' governor"
	help
	  This cpufreq governor sets the frequency statically to the
	  highest available CPU frequency.

	  To compile this driver as a module, choose M here: the
	  module will be called cpufreq_performance.

	  If in doubt, say Y.

config CPU_FREQ_GOV_POWERSAVE
	tristate "'powersave' governor"
	help
	  This cpufreq governor sets the frequency statically to the
	  lowest available CPU frequency.

	  To compile this driver as a module, choose M here: the
	  module will be called cpufreq_powersave.

	  If in doubt, say Y.

config CPU_FREQ_GOV_USERSPACE
	tristate "'userspace' governor for userspace frequency scaling"
	help
	  Enable this cpufreq governor when you either want to set the
	  CPU frequency manually or when a userspace program shall
	  be able to set the CPU dynamically, like on LART 
	  <http://www.lartmaker.nl/>.

	  To compile this driver as a module, choose M here: the
	  module will be called cpufreq_userspace.

	  For details, take a look at <file:Documentation/cpu-freq/>.

	  If in doubt, say Y.

config CPU_FREQ_GOV_ONDEMAND
	tristate "'ondemand' cpufreq policy governor"
	select CPU_FREQ_TABLE
	help
	  'ondemand' - This driver adds a dynamic cpufreq policy governor.
	  The governor does a periodic polling and 
	  changes frequency based on the CPU utilization.
	  The support for this governor depends on CPU capability to
	  do fast frequency switching (i.e, very low latency frequency
	  transitions). 

	  To compile this driver as a module, choose M here: the
	  module will be called cpufreq_ondemand.

	  For details, take a look at linux/Documentation/cpu-freq.

	  If in doubt, say N.

config CPU_FREQ_GOV_ONDEMANDX
	tristate "'ondemandx' cpufreq governor"
	depends on CPU_FREQ
	help
	  Basically an ondemand with suspend and wake profiles. When screen
	  is off, max frequency is capped at 500MHz. Even though ondemand
	  is the default governor in many kernels and is considered safe and
	  stable, the support for this governor depends on CPU capability to
	  do fast frequency switching which are very low latency frequency
	  transitions. Performance of ondemand/ondemandx varies for different
	  io schedulers. Ondemand/ondemandx goes best with SIO io scheduler.

config CPU_FREQ_GOV_INTERACTIVE
	tristate "'interactive' cpufreq policy governor"
	help
	  'interactive' - This driver adds a dynamic cpufreq policy governor
	  designed for latency-sensitive workloads.

	  This governor attempts to reduce the latency of clock
	  increases so that the system is more responsive to
	  interactive workloads.

	  To compile this driver as a module, choose M here: the
	  module will be called cpufreq_interactive.

	  For details, take a look at linux/Documentation/cpu-freq.

	  If in doubt, say N.

config CPU_FREQ_GOV_INTERACTIVEX
	tristate "'interactivex' cpufreq governor"
	depends on CPU_FREQ
	help
	  Created by kernel developer Imoseyon, the governor is based
	  heavily on the Interactive governor, enhanced with tuned timer
	  parameters for better balance. The defining feature is that it
	  locks the CPU frequency to the users lowest defined speed when
	  the screen is off.

config CPU_FREQ_GOV_CONSERVATIVE
	tristate "'conservative' cpufreq governor"
	depends on CPU_FREQ
	help
	  'conservative' - this driver is rather similar to the 'ondemand'
	  governor both in its source code and its purpose, the difference is
	  its optimisation for better suitability in a battery powered
	  environment.  The frequency is gracefully increased and decreased
	  rather than jumping to 100% when speed is required.

	  If you have a desktop machine then you should really be considering
	  the 'ondemand' governor instead, however if you are using a laptop,
	  PDA or even an AMD64 based computer (due to the unacceptable
	  step-by-step latency issues between the minimum and maximum frequency
	  transitions in the CPU) you will probably want to use this governor.

	  To compile this driver as a module, choose M here: the
	  module will be called cpufreq_conservative.

	  For details, take a look at linux/Documentation/cpu-freq.

	  If in doubt, say N.

config CPU_FREQ_GOV_SMARTASS2
	tristate "'smartassV2' cpufreq governor"
	depends on CPU_FREQ
	help
	  Version 2 of the original smartass governor from Erasmux. Favourite
	  for many people. The governor aims for an 'ideal frequency', and ramps
	  up aggressively twards this freq and less aggressive after. The motto
	  for this governor is a balance between performance and battery.

config CPU_FREQ_GOV_BRAZILIANWAX
	tristate "'brazilianwax' cpufreq governor"
	depends on CPU_FREQ
	help
	  A smartassV2 based governor. More aggressive ramping.

config CPU_FREQ_GOV_SAVAGEDZEN
	tristate "'savagedzen' cpufreq governor"
	depends on CPU_FREQ
	help
	  A smartassV2 based governor. Achieves good balance as compared to
	  to brazilianwax (another smartassV2 based governor).

config CPU_FREQ_GOV_ADAPTIVE
	tristate "'adaptive' cpufreq governor"
	depends on CPU_FREQ
	help
	  Dynamic governor designed for latency-sensitive workloads and 
	  also for demanding performance. Attempts to reduce the latency of
	  clock increases so that the system is more responsive to 
	  interactive workloads.

config CPU_FREQ_GOV_HYPER
	tristate "'hyper' cpufreq governor"
	depends on CPU_FREQ
	help
	  Formerly known as kenobi. Aggressive smart and smooth, and based on
	  Ondemand and equipped with several features of Ondemandx. In
	  suspend mode, the maxium frequency is 500MHz.

config CPU_FREQ_GOV_INTELLIDEMAND
	tristate "'intellidemand' cpufreq governor"
	depends on CPU_FREQ
	help
	  Intellidemand aka Intelligent Ondemand from Faux is based on
	  ondemand. Enters browsing mode to limit max frequency when GPU is
	  idling, and exits browsing mode and behaves like ondemand when GPU
	  is busy to deliver performance for gaming and such. Intellidemand
	  does not jump to highest frequency when screen is off.

config CPU_FREQ_GOV_LIONHEART
	tristate "'lionheart' cpufreq governor"
	depends on CPU_FREQ
	help
	  Conservative-based governor based on samsung update3 source.
	  Tunables (such as thresholds and sampling rate) changed so the
	  governor behaves more like the Performance one, with very
	  aggressive scaling.

config CPU_FREQ_GOV_LULZACTIVE
	tristate "'lulzactive' cpufreq governor"
	depends on CPU_FREQ
	help
	  Based on Interactive and Smartass governors. More user control
	  allowing user to set the threshold at which governor decides to
	  scale up or down. When screen is off, frequency is locked to 
	  global scaling minimum frequency.

config CPU_FREQ_GOV_MINMAX
	tristate "'minmax' cpufreq governor"
	depends on CPU_FREQ
	help
	  Simple governor that makes use of only the min and max frequencies
	  based on workload, NO intermediate frequencies are used.

menu "x86 CPU frequency scaling drivers"
depends on X86
source "drivers/cpufreq/Kconfig.x86"
endmenu

endif
endmenu
```

## fs/exfat/Kconfig
```kconfig
config EXFAT_FS
  tristate "Extended File Allocation Table file system support (non-fuse)"
  help
	exFAT (Extended File Allocation Table), (also sometimes referred to
	as FAT64) is a proprietary, patent-pending[2] file system suited
	especially for USB flash drives,[citation needed] introduced by Microsoft
	for embedded devices in Windows Embedded CE 6.0, in their desktop operating
	systems Windows Vista Service Pack 1[3] and Windows 7, and in their server
	operating system Windows Server 2008.[4]

	exFAT can be used where the NTFS file system is not a feasible solution,
	due to data structure overhead, or where the file size or directory restrictions
	of previous versions of the FAT file system are unacceptable
```
